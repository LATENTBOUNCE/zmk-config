
#define CONFIG_WIRELESS
#define ZMK_BASE_LAYER(name, LT, RT, LM, RM, LB, RB, LH, RH)                                      \
    ZMK_LAYER(                                                                                    \
        name,                                                                                     \
                &kp EQUAL &kp N1    &kp N2   &kp N3   &kp N4     &kp N5 &tog 1                                                           &mo SYS &kp N6 &kp N7 &kp N8    &kp N9   &kp N0   &kp MINUS \
                &kp TAB   LT                                            &none                                                            &none              RT                           &kp BSLH  \
                &kp ESC   LM                                            &none           &kp LCTRL &kp LALT &kp LGUI  &kp RCTRL           &none              RM                           &kp SQT   \
                &kp LSHFT LB                                                                      &kp HOME &kp PG_UP                                        RB                           &kp RSHFT \
                &mo 2     &kp GRAVE &kp CAPS &kp LEFT &kp RIGHT                              LH   &kp END  &kp PG_DN   RH                      &kp UP &kp DOWN  &kp LBKT &kp RBKT &mo 2)

#include "zmk-helpers/key-labels/adv360.h"
#include "base.keymap"

